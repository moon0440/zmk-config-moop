#include "moop.dtsi"

&kscan0 {
    col-gpios
        = <&pro_micro 15 GPIO_ACTIVE_HIGH> // col0 in the schematic
        , <&pro_micro 18 GPIO_ACTIVE_HIGH> // col1 in the schematic
        , <&pro_micro 19 GPIO_ACTIVE_HIGH> // col2 in the schematic
        , <&pro_micro 20 GPIO_ACTIVE_HIGH> // col3 in the schematic
        , <&pro_micro 21 GPIO_ACTIVE_HIGH> // col4 in the schematic
        ;
};