## config/boards/shields/moop/Kconfig.defconfig
```kconfig
if SHIELD_MOOP_LEFT

config ZMK_KEYBOARD_NAME
    default "Moop"

config ZMK_SPLIT_ROLE_CENTRAL
    default y

endif

if SHIELD_MOOP_LEFT || SHIELD_MOOP_RIGHT

config ZMK_SPLIT
    default y

endif
```

## config/boards/shields/moop/Kconfig.shield
```kconfig
config SHIELD_MOOP_LEFT
    def_bool $(shields_list_contains,moop_left)

config SHIELD_MOOP_RIGHT
    def_bool $(shields_list_contains,moop_right)
```
